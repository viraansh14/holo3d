/* HoloForge — POV volumetric display firmware (ESP32 + APA102/SK9822).
 *
 * WHAT THIS DOES
 * A vertical strip of APA102 LEDs is bolted to a spinning arm. A hall sensor
 * sees a magnet on the fixed base once per revolution. Knowing the rotation
 * period, we compute the current angle thousands of times a second and push the
 * matching column of pixels to the strip. Persistence of vision fuses the
 * columns into a 3D image hanging in a cylinder of air.
 *
 * WHY APA102 (not WS2812 / NeoPixel)
 * NeoPixels are clocked at ~800 kHz with strict timing — far too slow to repaint
 * a whole column hundreds of times per revolution. APA102/SK9822 use plain SPI
 * and run at many MHz, so a 40-LED column refreshes in microseconds. This is the
 * single most important parts choice. Do not substitute WS2812.
 *
 * WIRING (ESP32 dev board, all on the spinning arm; power via slip ring)
 *   APA102 CI (clock) -> GPIO 18      APA102 DI (data) -> GPIO 23
 *   APA102 5V/GND     -> 5V rail (slip ring) ; share GND with ESP32
 *   Hall A3144 OUT    -> GPIO 27 (interrupt) ; VCC 3V3 ; GND
 *   Big electrolytic cap (1000uF) across the 5V rail near the LEDs.
 *
 * FRAME DATA
 * Drop in a header generated by slicer/slice.py (e.g. globe.h) which defines
 * HOLO_ANGLES, HOLO_LEDS and HOLO_FRAME[angle][led] = 0xRRGGBB. If no header is
 * present the built-in demo (spinning spectrum + index spoke) runs so you can
 * verify the mechanics before worrying about content.
 */

#include <SPI.h>

// ---- include slicer output here, e.g.:  #include "globe.h" ----
#if !defined(HOLO_ANGLES)
  #define HOLO_ANGLES 120
  #define HOLO_LEDS   40
  #define HOLO_DEMO   1
#endif

// ---- pins ----
static const int PIN_CLK  = 18;
static const int PIN_DATA = 23;
static const int PIN_HALL = 27;

// ---- tuning ----
static const uint8_t BRIGHTNESS = 12;       // APA102 global brightness 0..31
static const uint32_t SPI_HZ    = 8000000;  // 8 MHz; lower if wires are long

// ---- revolution timing (written in ISR, read in loop) ----
volatile uint32_t lastIndexUs = 0;
volatile uint32_t periodUs    = 40000;      // ~1500 RPM seed (25 rev/s)
volatile uint32_t revCount    = 0;

void IRAM_ATTR onIndex() {
  uint32_t now = micros();
  uint32_t dt = now - lastIndexUs;
  if (dt > 2000) {                          // debounce (<30000 RPM)
    periodUs = dt;
    lastIndexUs = now;
    revCount++;
  }
}

SPIClass *hspi = nullptr;

void writeColumn(uint16_t angle) {
  // APA102 start frame.
  hspi->transfer(0x00); hspi->transfer(0x00); hspi->transfer(0x00); hspi->transfer(0x00);
  for (int z = 0; z < HOLO_LEDS; z++) {
    uint32_t rgb;
#if HOLO_DEMO
    // Demo: a rotating rainbow with a white index spoke and a green axis stripe.
    uint8_t h = (angle * 255 / HOLO_ANGLES + z * 3);
    uint8_t r = h, g = 255 - h, b = (h * 2);
    if (angle == 0) { r = g = b = 255; }                 // bright index line
    if (z == HOLO_LEDS / 2) { r = 0; g = 255; b = 80; }  // equator
    rgb = (r << 16) | (g << 8) | b;
#else
    rgb = HOLO_FRAME[angle][z];
#endif
    hspi->transfer(0xE0 | BRIGHTNESS);
    hspi->transfer(rgb & 0xFF);             // B
    hspi->transfer((rgb >> 8) & 0xFF);      // G
    hspi->transfer((rgb >> 16) & 0xFF);     // R
  }
  // End frame: at least LEDS/2 clock cycles of 1s to latch the last pixel.
  for (int i = 0; i < (HOLO_LEDS + 15) / 16; i++) hspi->transfer(0xFF);
}

void setup() {
  pinMode(PIN_HALL, INPUT_PULLUP);
  attachInterrupt(digitalPinToInterrupt(PIN_HALL), onIndex, FALLING);
  hspi = new SPIClass(HSPI);
  hspi->begin(PIN_CLK, -1, PIN_DATA, -1);
  hspi->beginTransaction(SPISaction());
}

// helper so the long type name doesn't clutter setup()
SPISettings SPISaction() { return SPISettings(SPI_HZ, MSBFIRST, SPI_MODE0); }

uint16_t lastAngle = 0xFFFF;

void loop() {
  uint32_t now = micros();
  uint32_t into = now - lastIndexUs;
  uint32_t p = periodUs ? periodUs : 40000;
  // Current angular slice.
  uint16_t angle = (uint16_t)(((uint64_t)into * HOLO_ANGLES) / p) % HOLO_ANGLES;
  if (angle != lastAngle) {                 // only repaint when the slice changes
    writeColumn(angle);
    lastAngle = angle;
  }
}
